## board/freescale/mx6ul_flex_winkhub2/Kconfig
```kconfig
if TARGET_MX6UL_FLEX_WINKHUB2

config SYS_BOARD
	default "mx6ul_flex_winkhub2"

config SYS_VENDOR
	default "freescale"

config SYS_SOC
	default "mx6"

config SYS_CONFIG_NAME
	default "mx6ul_flex_winkhub2"

endif
```

## configs/mx6ul_flex_winkhub2_defconfig
```kconfig
CONFIG_SYS_EXTRA_OPTIONS="IMX_CONFIG=board/freescale/mx6ul_flex_winkhub2/imximage.cfg,MX6UL,SYS_BOOT_NAND"
CONFIG_ARM=y
CONFIG_TARGET_MX6UL_FLEX_WINKHUB2=y
CONFIG_DM=y
CONFIG_DM_THERMAL=y

CONFIG_CMD_MEMINFO=y
```
